## boards/seeed/xiao_rp2350/Kconfig.xiao_rp2350
```kconfig
config BOARD_XIAO_RP2350
	select SOC_RP2350A_M33 if BOARD_XIAO_RP2350_RP2350A_M33_ZMK
```

## boards/seeed/xiao_rp2350/board.yml
```yaml
board:
  name: xiao_rp2350
  vendor: seeed
  socs:
    - name: rp2350a
      variants:
        - name: zmk
          cpucluster: m33
```

## config/boards/seeed/xiao_rp2350/board.yml
```yaml
board:
  extend: xiao_rp2350
  variants:
    - name: zmk
      qualifier: rp2350
```

## config/boards/shields/my_macropad/Kconfig.defconfig
```kconfig
# Copyright (c) 2024 The ZMK Contributors
# SPDX-License-Identifier: MIT

if SHIELD_MY_MACROPAD

config ZMK_KEYBOARD_NAME
    default "My Macropad"

endif
```
